/*@!Encoding:1252*/

/*
 * Utilities computing CRC16.
 * 
 * Part of the CAPL Utils library, available under GNU v3.0 on github
 * https://github.com/daemonPainter/CAPL-Utils
 */

includes
{
  #include "LUT\LU_CRC16_CCITT.cin"
  #include "LUT\LU_CRC16_ARC.cin"
  #include "LUT\LU_CRC16_CDMA2000.cin"
}

word computeCRC16_CCITT(byte input[], int nBytes)
{
    byte data;
    word remainder = 0xFFFF;
    int B = 0;
    for (B = 0; B < nBytes; ++B)
    {
        data = input[B] ^ (remainder >> (8));
        remainder = CRC16_LUT_CCITT[data] ^ (remainder << 8);
    }
    return ( (remainder) ^ 0x0000 );
}

word computeCRC16_ARC(byte input[], int nBytes)
{
    byte data;
    word remainder = 0xFFFF;
    int B = 0;
    for (B = 0; B < nBytes; ++B)
    {
        data = input[B] ^ (remainder >> (8));
        remainder = CRC16_LUT_ARC[data] ^ (remainder << 8);
    }
    return ( (remainder) ^ 0x0000 );
}

word computeCRC16_CDMA2000(byte input[], int nBytes)
{
    byte data;
    word remainder = 0xFFFF;
    int B = 0;
    for (B = 0; B < nBytes; ++B)
    {
        data = input[B] ^ (remainder >> (8));
        remainder = CRC16_LUT_CDMA2000[data] ^ (remainder << 8);
    }
    return ( (remainder) ^ 0x0000 );
}